// reface_cp_chain.h
//
// Yamaha Reface CP master effect chain.
//   voice -> DRIVE -> [1] TREMOLO/WAH -> [2] CHORUS/PHASER
//         -> [3] D.DELAY/A.DELAY -> [4] REVERB -> VOLUME
//
// Header-only, no heap. RP2350 (Cortex-M33 FPU) + macOS host (Clang C++17).
// Generated by glm-5.2:cloud, formally reviewed; assembled by the orchestrator.

#pragma once
#include <cmath>
#include "cp_hot.h"         // CP_HOT() RAM placement (Pico) / no-op (host)
#include "reface_cp_fx.h"   // CpTremolo, CpChorus, CpPhaser, CpDelay, cp_clamp01
#include "dsp_reverb.h"     // class Reverb { init(sr); setDepth(0..1); process(float&,float&); reset(); }
#include "wahwah.h"         // standalone WahWah (Mk8WahCore) — avoids dragging effect_chain.h (<iostream>/<vector>) into firmware

class RefaceCpChain {
public:
    enum VoiceType { RDI=0, RDII=1, WR=2, CLV=3, PIANO=4, CP=5 };
    enum Tw        { TW_OFF=0, TW_TREMOLO=1, TW_WAH=2 };
    enum Cp2       { CP_OFF=0, CP_CHORUS=1, CP_PHASER=2 };
    enum Dly       { DLY_OFF=0, DLY_DIGITAL=1, DLY_ANALOG=2 };

    void init(float sampleRate) {
        _sr = sampleRate;
        _trem.init(_sr);
        _wah.init(_sr);
        _chorus.init(_sr);
        _phaser.init(_sr);
        _delay.init(_sr);
        _reverb.init(_sr);
        // one-pole env follower coeffs: attack ~8ms, release ~120ms
        float attTau = 0.008f;
        float relTau = 0.120f;
        _envAtt = std::exp(-1.0f / (_sr * attTau));
        _envRel = std::exp(-1.0f / (_sr * relTau));
        reset();
    }

    void reset() {
        _trem.reset();
        _wah.reset();
        _chorus.reset();
        _phaser.reset();
        _delay.reset();
        _reverb.reset();
        _envL = 0.0f;
        _envR = 0.0f;
    }

    // ---- voice ----
    inline void setVoiceType(int v) {
        _voiceType = v;
        int mode = (v == RDI || v == RDII || v == CP) ? 0 : 1; // PAN or VOLUME
        _trem.setMode(mode);
    }
    inline int getVoiceType() const { return _voiceType; }

    // ---- drive ----
    inline void setDrive(float n) { _drive = cp_clamp01(n); }
    inline float getDrive() const { return _drive; }

    // ---- volume ----
    inline void setVolume(float n) { _volume = cp_clamp01(n); }
    inline float getVolume() const { return _volume; }
    // MIDI CC11 Expression (multiplies master volume)
    inline void setExpression(float n) { _expr = cp_clamp01(n); }
    inline float getExpression() const { return _expr; }
    // Pre-FX gain (attenuate before Drive/FX chain to avoid clipping)
    inline void setPreGain(float n) { _preGain = cp_clamp01(n); }
    inline float getPreGain() const { return _preGain; }

    // ---- effect 1: tremolo / wah ----
    inline void setTremWahMode(int m) { _twMode = m; }
    inline int getTremWahMode() const { return _twMode; }

    inline void setTremWahDepth(float n) {
        _twDepth = cp_clamp01(n);
        _trem.setDepth(_twDepth);
        _wah.setEnvelopeAmount(_twDepth);
    }
    inline float getTremWahDepth() const { return _twDepth; }

    inline void setTremWahRate(float n) {
        _twRate = cp_clamp01(n);
        _trem.setRate(_twRate);
        _wah.setMidGainNorm(_twRate);
    }
    inline float getTremWahRate() const { return _twRate; }

    // ---- effect 2: chorus / phaser ----
    inline void setChoPhaMode(int m) { _cpMode = m; }
    inline int getChoPhaMode() const { return _cpMode; }

    inline void setChoPhaDepth(float n) {
        _cpDepth = cp_clamp01(n);
        _chorus.setDepth(_cpDepth);
        _phaser.setDepth(_cpDepth);
    }
    inline float getChoPhaDepth() const { return _cpDepth; }

    inline void setChoPhaSpeed(float n) {
        _cpSpeed = cp_clamp01(n);
        _chorus.setRate(_cpSpeed);
        _phaser.setSpeed(_cpSpeed);
    }
    inline float getChoPhaSpeed() const { return _cpSpeed; }

    // ---- effect 3: delay ----
    inline void setDelayMode(int m) {
        _dlyMode = m;
        if (m == 1) _delay.setMode(0);
        else if (m == 2) _delay.setMode(1);
    }
    inline int getDelayMode() const { return _dlyMode; }

    inline void setDelayDepth(float n) {
        _dlyDepth = cp_clamp01(n);
        _delay.setDepth(_dlyDepth);
    }
    inline float getDelayDepth() const { return _dlyDepth; }

    inline void setDelayTime(float n) {
        _dlyTime = cp_clamp01(n);
        _delay.setTime(_dlyTime);
    }
    inline float getDelayTime() const { return _dlyTime; }

    // ---- effect 4: reverb ----
    inline void setReverbDepth(float n) {
        _rvDepth = cp_clamp01(n);
        _reverb.setDepth(_rvDepth);
    }
    inline float getReverbDepth() const { return _rvDepth; }

    // ---- process (defined inline below) ----
    void process(float* l, float* r, int numFrames);

private:
    float _sr = 44100.0f;

    // params
    int   _voiceType = RDI;
    float _drive     = 0.0f;
    float _volume    = 1.0f;
    float _expr      = 1.0f;
    float _preGain   = 1.0f;

    int   _twMode    = TW_OFF;
    float _twDepth   = 0.0f;
    float _twRate    = 0.0f;

    int   _cpMode    = CP_OFF;
    float _cpDepth   = 0.0f;
    float _cpSpeed   = 0.0f;

    int   _dlyMode   = DLY_OFF;
    float _dlyDepth  = 0.0f;
    float _dlyTime   = 0.0f;

    float _rvDepth   = 0.0f;

    // primitives
    CpTremolo _trem;
    WahWah    _wah;
    CpChorus  _chorus;
    CpPhaser  _phaser;
    CpDelay   _delay;
    Reverb    _reverb;

    // wah envelope follower state
    float _envL   = 0.0f;
    float _envR   = 0.0f;
    float _envAtt = 0.0f;
    float _envRel = 0.0f;
};

// ============================================================================
// process() — per-sample chain assembly (header-only inline definition)
// ============================================================================
inline void CP_HOT(RefaceCpChain::process)(float* l, float* r, int numFrames) {
    for (int i = 0; i < numFrames; ++i) {
        float L = l[i];
        float R = r[i];
        if (_preGain < 0.9999f) {
            L *= _preGain;
            R *= _preGain;
        }

        if (_drive > 0.0001f) {
            float pre = 1.0f + _drive * 11.0f;
            float mk = 0.7f + 0.3f * (1.0f - _drive);
            L = fastTanh(L * pre) * mk;
            R = fastTanh(R * pre) * mk;
        }

        if (_twMode == 1) {
            _trem.process(L, R);
        } else if (_twMode == 2) {
            float aL = fabsf(L);
            _envL = (aL > _envL) ? (_envAtt * _envL + (1.0f - _envAtt) * aL)
                                 : (_envRel * _envL + (1.0f - _envRel) * aL);
            float aR = fabsf(R);
            _envR = (aR > _envR) ? (_envAtt * _envR + (1.0f - _envAtt) * aR)
                                 : (_envRel * _envR + (1.0f - _envRel) * aR);
            _wah.processStereo(L, R, _envL, _envR);
        }

        if (_cpMode == 1) {
            _chorus.process(L, R);
        } else if (_cpMode == 2) {
            _phaser.process(L, R);
        }

        if (_dlyMode != 0) {
            _delay.process(L, R);
        }

        if (_rvDepth > 0.0001f) {
            _reverb.process(L, R);
        }

        const float vol = _volume * _expr;
        L *= vol;
        R *= vol;

        l[i] = L;
        r[i] = R;
    }
}
