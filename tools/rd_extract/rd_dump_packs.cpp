// rd_dump_packs.cpp
// Tiny host tool that writes the 16 embedded .rdp packs back to files,
// so the regression tests exactly the data the firmware ships.
// Generated by glm-5.2:cloud, formally reviewed by the orchestrator.

#include "rd_packs_data.h"

#include <cstdint>
#include <cstdio>
#include <cstring>

int main(int argc, char** argv) {
    if (argc != 2) {
        std::fprintf(stderr, "usage: rd_dump_packs <outdir>\n");
        return 1;
    }

    const char* outdir = argv[1];

    for (int i = 0; i < 16; ++i) {
        char path[512];
        std::snprintf(path, sizeof(path), "%s/pack_p%d.rdp", outdir, i);

        std::FILE* f = std::fopen(path, "wb");
        if (!f) {
            std::fprintf(stderr, "rd_dump_packs: fopen failed for %s\n", path);
            return 1;
        }

        size_t wrote = std::fwrite(rd_pack_ptrs[i], 1, rd_pack_sizes[i], f);
        if (wrote != rd_pack_sizes[i]) {
            std::fprintf(stderr, "rd_dump_packs: fwrite failed for %s\n", path);
            std::fclose(f);
            return 1;
        }

        std::fclose(f);
    }

    std::printf("dumped 16 packs to %s\n", outdir);
    return 0;
}
